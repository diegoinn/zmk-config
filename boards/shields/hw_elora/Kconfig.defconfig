## boards/shields/hw_elora/Kconfig.defconfig
```kconfig
if SHIELD_HW_ELORA_LEFT

# Name must be less than 16 characters long!
config ZMK_KEYBOARD_NAME
    default "HW Elora"

config ZMK_SPLIT_ROLE_CENTRAL
    default y

endif

if SHIELD_HW_ELORA_LEFT || SHIELD_HW_ELORA_RIGHT

config ZMK_SPLIT
    default y

endif
```

## boards/shields/hw_elora/Kconfig.shield
```kconfig
# No whitespace after the comma or in your part name!
config SHIELD_HW_ELORA_LEFT
    def_bool $(shields_list_contains,hw_elora_left)

# No whitespace after the comma or in your part name!
config SHIELD_HW_ELORA_RIGHT
    def_bool $(shields_list_contains,hw_elora_right)
```
